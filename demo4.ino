#include <Adafruit_CircuitPlayground.h>
#include <AsyncDelay.h>

#define BUTTON_PIN 4
#define MIDDLE_POSITION1 4
#define MIDDLE_POSITION2 5

const uint8_t spSCORE[]     PROGMEM = {0x06,0xF8,0x46,0xCB,0x00,0x4F,0x79,0x28,0xE0,0x3B,0x75,0x03,0xFC,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0x51,0x65};
const uint8_t spSTART[]     PROGMEM = {0x08,0xD8,0x50,0x05,0x01,0x5F,0xB1,0x12,0xE0,0x33,0x55,0x06,0x7C,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0x15,0x65};
const uint8_t spBAD[]       PROGMEM = {0x08,0x00,0x71,0xC2,0x98,0xD1,0xA7,0xA9,0x5A,0xAA,0x13,0x14,0x15,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0x51,0x21};
const uint8_t spRESET[]     PROGMEM = {0xAA,0xF0,0x4D,0x54,0x22,0x5B,0xFB,0xAC,0xC5,0x49,0x53,0x66,0x5A,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0x51,0x25};


volatile bool gameFailed = false;
volatile bool buttonPressed = false;
volatile unsigned long lastDebounceTime = 0;  // the last time the output pin was toggled
const unsigned long debounceDelay = 200;      // the debounce time; increase if the output flickers

int lightPosition = 0;
int speed = 200;  // Initial speed (milliseconds between each position change)
bool movingForward = true;

AsyncDelay lightDelay;

void setup() {
  CircuitPlayground.begin();
  attachInterrupt(digitalPinToInterrupt(BUTTON_PIN), handleButtonPress, RISING);
  CircuitPlayground.clearPixels();
  Serial.begin(9600);
  Serial.println("Game starting...");
      	CircuitPlayground.speaker.say(spSTART);


  lightDelay.start(speed, AsyncDelay::MILLIS);
}

void loop() {
  // Read the slide switch state
  bool slideSwitch = CircuitPlayground.slideSwitch();

  if (gameFailed) {
    if (!slideSwitch) { // Reset game when switch is flipped to the right
      resetGame();
      CircuitPlayground.speaker.say(spRESET);

    } else {
      allOn(0xFF0000); // Hold the red light
    }
  } else {
    // Update light position
    if (lightDelay.isExpired()) {
      lightDelay.restart();
      updateLightPosition();
    }

    // Check for button press
    if (buttonPressed) {
      buttonPressed = false; // Reset the flag
      Serial.println("Button pressed!");
      handleButtonPressLogic();
    }
  }
}

void updateLightPosition() {
  if (!gameFailed) {
    CircuitPlayground.clearPixels();
    CircuitPlayground.setPixelColor(lightPosition, 0, 0, 255); // Blue light

    if (movingForward) {
      lightPosition++;
      if (lightPosition >= 9) {
        movingForward = false;
      }
    } else {
      lightPosition--;
      if (lightPosition <= 0) {
        movingForward = true;
      }
    }

    Serial.print("Light position: ");
    Serial.println(lightPosition);
  }
}

void handleButtonPressLogic() {
  if (lightPosition == MIDDLE_POSITION1 || lightPosition == MIDDLE_POSITION2) {
    // Success: Flash white and increase speed
    Serial.println("Success! Light is in the middle.");
    playSuccessSequence();
    speed = max(speed - 20, 10); // Increase speed, minimum speed 10ms
    lightDelay.start(speed, AsyncDelay::MILLIS);
  } else {
    // Failure: Hold red light and wait for switch flip
    Serial.println("Fail! Light is not in the middle.");
    playFailSequence();
    gameFailed = true; // Set game to failed
  }
}

void playSuccessSequence() {
  for (int i = 0; i < 3; i++) {
    allOn(0xFFFFFF);
    delay(100);
    CircuitPlayground.clearPixels();
    delay(100);
  }
  CircuitPlayground.playTone(1000, 200); // Play success sound
    	CircuitPlayground.speaker.say(spSCORE);

}

void playFailSequence() {
  allOn(0xFF0000); // Hold red light
  CircuitPlayground.playTone(500, 200); // Play fail sound
    	CircuitPlayground.speaker.say(spBAD);

}

void handleButtonPress() {
  unsigned long currentTime = millis();
  if ((currentTime - lastDebounceTime) > debounceDelay) {
    lastDebounceTime = currentTime;
    buttonPressed = true;
    Serial.println("button press");
  }
}

void resetGame() {
  gameFailed = false;
  lightPosition = 0;
  speed = 200;  // Reset speed to initial value
  movingForward = true;
  lightDelay.start(speed, AsyncDelay::MILLIS);
  Serial.println("Switch flipped: Game reset");
}

void allOn(int color) {
  for (int i = 0; i < 10; i++) {
    CircuitPlayground.setPixelColor(i, color);
  }
}
